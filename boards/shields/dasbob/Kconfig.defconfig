## boards/shields/dasbob/Kconfig.defconfig
```kconfig
if SHIELD_DASBOB_LEFT

config ZMK_KEYBOARD_NAME
    default "DASBOB"

config ZMK_SPLIT_ROLE_CENTRAL
    default y

# Disable Bluetooth for wired operation
config BT
    default n

config ZMK_BLE
    default n

# Enable USB for wired connection
config ZMK_USB
    default y

endif

if SHIELD_DASBOB_LEFT || SHIELD_DASBOB_RIGHT

config ZMK_SPLIT
    default y

endif
```
